## Kconfig
```kconfig
menu "LWGSM"

config LWGSM_TX
    int "Modem TX PIN"
    default 25
    help
        GSM Modem TX pin connected to the ESP

config LWGSM_RX
    int "Modem RX PIN"
    default 26
    help
        GSM Modem RX pin connected to the ESP

endmenu
```
